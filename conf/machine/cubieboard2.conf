## conf/machine/cubieboard2.conf
```bitbake
#@TYPE: Machine
#@NAME: CubieBoard2
#@DESCRIPTION: Machine configuration for the cubieboard2, based on allwinner ar210 CPU http://cubieboard.org/

# Only has DVI connector for external screen
GUI_MACHINE_CLASS = "bigscreen"

require conf/machine/include/tune-cortexa7.inc
require conf/machine/include/sunxi.inc
require conf/machine/include/sunxi-mali.inc

UBOOT_MACHINE = "cubieboard2"
UBOOT_ENTRYPOINT = "0x40008000"
UBOOT_LOADADDRESS = "0x40008000"

SERIAL_CONSOLE = "115200 ttyS0"

MACHINE_ESSENTIAL_EXTRA_RRECOMMENDS += "\
 kernel-module-sunxi-emac \
 kernel-module-rt2800usb \
 kernel-module-snd-usb-audio \
 kernel-module-cp210x \
 "

#autoload ethernet module at boot
module_autoload_sunxi_emac = "sunxi_emac"
module_autoload_rt2800usb = "rt2800usb"

MACHINE_FEATURES = "screen apm usbgadget usbhost vfat alsa"

#firmware for ralink wifi
IMAGE_INSTALL += "linux-firmware-ralink"
```
